VERSION ""

NS_ :

BS_:

BU_: Tester Sensor

BO_ 1024 Simple: 8 Sensor
 SG_ Page M : 0|8@1+ (1,0) [0|255] "" Tester
 SG_ Voltage m0 : 8|16@1+ (0.001,0) [0|65.535] "V" Tester
 SG_ Current m0 : 24|16@1- (0.01,0) [-327.68|327.67] "A" Tester
 SG_ Speed m1 : 8|16@1+ (1,0) [0|65535] "rpm" Tester
 SG_ Position m1 : 24|32@1+ (0.001,0) [0|4294967.295] "mm" Tester
 SG_ Counter : 56|8@1+ (1,0) [0|255] "" Tester

BO_ 1025 Extended: 8 Sensor
 SG_ Group M : 0|4@1+ (1,0) [0|15] "" Tester
 SG_ Channel m0M : 4|4@1+ (1,0) [0|15] "" Tester
 SG_ Raw m1 : 8|16@1+ (1,0) [0|65535] "" Tester
 SG_ Filtered m2 : 8|16@1+ (1,0) [0|65535] "" Tester
 SG_ Status m3 : 8|8@1+ (1,0) [0|255] "" Tester
 SG_ Diagnostic m15 : 8|32@1+ (1,0) [0|4294967295] "" Tester

CM_ BO_ 1025 "Group chooses; under group 0, Channel chooses again.";
VAL_ 1024 Page 0 "Electrical" 1 "Mechanical" ;
SG_MUL_VAL_ 1025 Channel Group 0-0;
SG_MUL_VAL_ 1025 Raw Channel 1-1;
SG_MUL_VAL_ 1025 Filtered Channel 2-2, 4-5;
SG_MUL_VAL_ 1025 Status Group 3-3;
SG_MUL_VAL_ 1025 Diagnostic Group 15-15;
