ASAP2_VERSION 1 60
/begin PROJECT pycangui_demo "pycangui demo"
/begin MODULE demo "demo ECU"
/begin MOD_PAR "demo ECU memory" /* The software this file is for, and where the slave keeps its own name
for it: the XCP pane compares the two on connecting. */ EPK "pycangui demo 1.0" ADDR_EPK 0x0F00
 /begin MEMORY_SEGMENT ram "measurements and calibration" DATA RAM INTERN 0x1000 0x2000 -1 -1 -1 -1 -1 /end MEMORY_SEGMENT
 /begin MEMORY_SEGMENT code "program flash" CODE FLASH INTERN 0x4000 0x4000 -1 -1 -1 -1 -1 /end MEMORY_SEGMENT
/end MOD_PAR
/* What the Transfer tab flashes, and in which order. The header is erased
first and written last, so a flash cut short leaves no valid header
pointing at half an application. */
/begin IF_DATA XCP /* Version, then the timeouts T1 to T7 in milliseconds: commands, checksum,
PROGRAM_START, PROGRAM_CLEAR, PROGRAM, CONNECT, and the wait before a
busy slave is asked again. Then the packet sizes, order and granularity. */
 /begin PROTOCOL_LAYER 0x0104 1000 30000 30000 30000 30000 1000 200 8 8 BYTE_ORDER_MSB_LAST ADDRESS_GRANULARITY_BYTE /end PROTOCOL_LAYER
 /begin PGM PGM_MODE_ABSOLUTE 2 8 /begin SECTOR "application" 0 0x4000 0x3000 1 0 0x00 /end SECTOR /begin SECTOR "header" 1 0x7000 0x1000 0 1 0x00 /end SECTOR /end PGM
 /begin CHECKSUM XCP_CRC_32 MAX_BLOCK_SIZE 0x100 /end CHECKSUM
/end IF_DATA
/* The CCP slave's checksum: procedure 2 is XCP's ADD_12, a 16-bit sum of the
bytes, and it sums up to 0x100 bytes at a time. */
/begin IF_DATA ASAP1B_CCP
 /begin TP_BLOB 0x201 0x204 0x7B0 0x7B1 0x0001 1 /begin CHECKSUM_PARAM 0x02 0x100 CHECKSUM_CALCULATION_ACTIVE_PAGE /end CHECKSUM_PARAM /end TP_BLOB
/end IF_DATA
/begin COMPU_METHOD rpm_conv "engine speed" RAT_FUNC "%.1f" "rpm" COEFFS 0 1 0 0 0 1 /end COMPU_METHOD
/begin COMPU_METHOD volt_conv "battery voltage" RAT_FUNC "%.2f" "V" COEFFS 0 100 0 0 0 1 /end COMPU_METHOD
/begin RECORD_LAYOUT RL_UWORD FNC_VALUES 1 UWORD COLUMN_DIR DIRECT /end RECORD_LAYOUT
/begin MEASUREMENT EngineSpeed "Engine speed" UWORD rpm_conv 0 0 0 8000 ECU_ADDRESS 0x1000 /end MEASUREMENT
/begin MEASUREMENT BatteryVoltage "Battery voltage" UWORD volt_conv 0 0 0 1600 ECU_ADDRESS 0x1002 /end MEASUREMENT
/begin MEASUREMENT CoolantTemp "Coolant temperature" SWORD NO_COMPU_METHOD 0 0 -40 215 ECU_ADDRESS 0x1004 /* No conversion, so no unit from one: the measurement gives its own. */ PHYS_UNIT "degC" FORMAT "%4.0" /end MEASUREMENT
/begin CHARACTERISTIC SpeedLimit "Maximum engine speed" VALUE 0x2000 RL_UWORD 0 rpm_conv 0 8000 /end CHARACTERISTIC
/begin CHARACTERISTIC IdleTarget "Idle speed target" VALUE 0x2002 RL_UWORD 0 rpm_conv 0 2000 /end CHARACTERISTIC
/* A curve and a map, laid out as resources/demo.a2l's record layouts say.
The curve keeps its number of points in front of them, as many ECUs do, so
the pane reads that first; the map's speed axis is shared (an AXIS_PTS),
and its load axis is fixed, worked out from the file and never read. */
/begin COMPU_METHOD ign_conv "ignition advance" LINEAR "%.1f" "deg" COEFFS_LINEAR 0.5 0 /end COMPU_METHOD
/begin COMPU_METHOD load_conv "engine load" IDENTICAL "%.0f" "%" /end COMPU_METHOD
/begin RECORD_LAYOUT RL_COUNTED_CURVE NO_AXIS_PTS_X 1 UBYTE AXIS_PTS_X 2 SWORD INDEX_INCR DIRECT FNC_VALUES 3 UWORD COLUMN_DIR DIRECT /end RECORD_LAYOUT
/begin RECORD_LAYOUT RL_AXIS_UWORD AXIS_PTS_X 1 UWORD INDEX_INCR DIRECT /end RECORD_LAYOUT
/begin RECORD_LAYOUT RL_SBYTE_ROWS FNC_VALUES 1 SBYTE ROW_DIR DIRECT /end RECORD_LAYOUT
/begin AXIS_PTS SpeedAxis "Engine speeds the ignition map is given at" 0x2200 EngineSpeed RL_AXIS_UWORD 0 rpm_conv 5 0 8000 /end AXIS_PTS
/begin CHARACTERISTIC IdleCurve "Idle speed against coolant temperature" CURVE 0x2100 RL_COUNTED_CURVE 0 rpm_conv 0 2000 /begin AXIS_DESCR STD_AXIS CoolantTemp NO_COMPU_METHOD 8 -40 215 /end AXIS_DESCR /end CHARACTERISTIC
/begin CHARACTERISTIC IgnitionMap "Ignition advance by engine speed and load" MAP 0x2300 RL_SBYTE_ROWS 0 ign_conv -20 50
 /begin AXIS_DESCR COM_AXIS EngineSpeed rpm_conv 5 0 8000 AXIS_PTS_REF SpeedAxis /end AXIS_DESCR
 /begin AXIS_DESCR FIX_AXIS NO_INPUT_QUANTITY load_conv 5 0 100 FIX_AXIS_PAR_DIST 0 25 5 /end AXIS_DESCR
/end CHARACTERISTIC
/* Text: a part number, sixteen bytes, NULs after it. */
/begin RECORD_LAYOUT RL_TEXT FNC_VALUES 1 UBYTE ROW_DIR DIRECT /end RECORD_LAYOUT
/begin CHARACTERISTIC PartNumber "Part number" ASCII 0x2400 RL_TEXT 0 NO_COMPU_METHOD 0 255 NUMBER 16 /end CHARACTERISTIC
/* How the file sorts its parameters: groups, one inside another, and a
function. The XCP pane's Group box shows one at a time. */
/begin GROUP Engine "The engine" ROOT /begin REF_MEASUREMENT EngineSpeed CoolantTemp /end REF_MEASUREMENT /begin REF_CHARACTERISTIC SpeedLimit /end REF_CHARACTERISTIC /begin SUB_GROUP Idle Ignition /end SUB_GROUP /end GROUP
/begin GROUP Idle "Idle speed" /begin REF_CHARACTERISTIC IdleTarget IdleCurve /end REF_CHARACTERISTIC /end GROUP
/begin GROUP Ignition "Ignition timing" /begin REF_CHARACTERISTIC IgnitionMap SpeedAxis /end REF_CHARACTERISTIC /end GROUP
/begin GROUP Supply "Power supply" ROOT /begin REF_MEASUREMENT BatteryVoltage /end REF_MEASUREMENT /end GROUP
/begin GROUP Identification "What this ECU is" ROOT /begin REF_CHARACTERISTIC PartNumber /end REF_CHARACTERISTIC /end GROUP
/begin FUNCTION IdleControl "Holds the engine at its idle speed" /begin DEF_CHARACTERISTIC IdleTarget IdleCurve /end DEF_CHARACTERISTIC /begin IN_MEASUREMENT EngineSpeed CoolantTemp /end IN_MEASUREMENT /end FUNCTION
/end MODULE
/end PROJECT
